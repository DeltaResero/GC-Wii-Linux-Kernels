## drivers/exi/Kconfig
```kconfig
#
# Nintendo GameCube EXI (Expansion Interface) support.
#

if GAMECUBE

menu "EXI (Expansion Interface) support"

config GAMECUBE_EXI
	bool "EXI (Expansion Interface) support (EXPERIMENTAL)"
	depends on EXPERIMENTAL
	default y
	help
	  On the Expansion Interface sit the memory card slots,
	  serial ports I & II, the Mask ROM, RTC, SRAM and UART.

	  If in doubt, say Y here.

config GAMECUBE_RTC
	bool "Real Time Clock and SRAM support"
	depends on GAMECUBE_EXI
	default y
	help
	  If you say yes to this option, support will be included for the
	  Real Time Clock and SRAM of the Nintendo GameCube.
	  
	  If in doubt, say Y here.

endmenu

endif
```

## drivers/staging/zcache/Kconfig
```kconfig
config ZCACHE
	bool "Dynamic compression of swap pages and clean pagecache pages"
	depends on CLEANCACHE || FRONTSWAP
	select XVMALLOC
	default n
	help
	  Zcache doubles RAM efficiency while providing a significant
	  performance boosts on many workloads.  Zcache uses lzo1x
	  compression and an in-kernel implementation of transcendent
	  memory to store clean page cache pages and swap in RAM,
	  providing a noticeable reduction in disk I/O.
	  
choice ZCACHE_COMPRESS
	prompt "compression method"
	depends on ZCACHE
	default ZCACHE_LZO
	help
	  Select the compression method used by zcache.
	  LZO is the default. Snappy compresses a bit worse (around ~2%) but
	  much (~2x) faster, at least on x86-64.
config ZCACHE_LZO
	bool "LZO compression"
	select LZO_COMPRESS
	select LZO_DECOMPRESS
config ZCACHE_SNAPPY
	bool "Snappy compression"
	depends on SNAPPY_COMPRESS
	depends on SNAPPY_DECOMPRESS
endchoice
```

## drivers/staging/zram/Kconfig
```kconfig
config XVMALLOC
	bool
	default n

config ZRAM
	tristate "Compressed RAM block device support"
	depends on BLOCK && SYSFS
	select XVMALLOC
	default n
	help
	  Creates virtual block devices called /dev/zramX (X = 0, 1, ...).
	  Pages written to these disks are compressed and stored in memory
	  itself. These disks allow very fast I/O and compression provides
	  good amounts of memory savings.

	  It has several use cases, for example: /tmp storage, use as swap
	  disks and maybe many more.

	  See zram.txt for more information.
	  Project home: http://compcache.googlecode.com/

config ZRAM_NUM_DEVICES
	int "Default number of zram devices"
	depends on ZRAM
	range 1 32
	default 1
	help
	  Select default number of zram devices. You can override this value
	  using 'num_devices' module parameter.

config ZRAM_DEFAULT_PERCENTAGE
	int "Default number of zram percentage"
	depends on ZRAM
	range 10 80
	default 25
	help
	  Select default zram disk size: percentage of total RAM

choice ZRAM_COMPRESS
	prompt "compression method"
	depends on ZRAM
	default ZRAM_LZO
	help
	  Select the compression method used by zram.
	  LZO is the default. Snappy compresses a bit worse (around ~2%) but
	  much (~2x) faster, at least on x86-64.

config ZRAM_LZO
	bool "LZO compression"
	select LZO_COMPRESS
	select LZO_DECOMPRESS

config ZRAM_SNAPPY
	bool "Snappy compression"
	depends on SNAPPY_COMPRESS
	depends on SNAPPY_DECOMPRESS

endchoice

config ZRAM_DEFAULT_DISKSIZE
	int "Default size of zram in bytes"
	depends on ZRAM
	default 33554432
	help
	  Set default zram disk size (default ~ 32MB, recommend 1/2 RAM size)
```
